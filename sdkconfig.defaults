## sdkconfig.defaults
```kconfig
# CoreFS Ultimate - Build Configuration
# ESP32-C6, 4MB Flash, USB CDC Console

# ============================================
# Target & Flash
# ============================================
CONFIG_IDF_TARGET="esp32c6"
CONFIG_ESPTOOLPY_FLASHSIZE_4MB=y
CONFIG_ESPTOOLPY_FLASHSIZE="4MB"

# ============================================
# Partition Table
# ============================================
CONFIG_PARTITION_TABLE_CUSTOM=y
CONFIG_PARTITION_TABLE_CUSTOM_FILENAME="partitions.csv"
CONFIG_PARTITION_TABLE_FILENAME="partitions.csv"

# ============================================
# Console Configuration (UART, not USB-Serial-JTAG)
# ============================================
CONFIG_ESP_CONSOLE_UART_DEFAULT=y
CONFIG_ESP_CONSOLE_UART_NUM=0
CONFIG_ESP_CONSOLE_UART_BAUDRATE=115200

# ============================================
# USB Configuration
# ============================================
# UART Console (not USB) to avoid linker issues
# If you want USB Serial JTAG later:
# CONFIG_ESP_CONSOLE_USB_SERIAL_JTAG=y
# CONFIG_ESP_CONSOLE_SECONDARY_USB_SERIAL_JTAG=y

# ============================================
# Compiler Optimization
# ============================================
CONFIG_COMPILER_OPTIMIZATION_SIZE=y
CONFIG_COMPILER_OPTIMIZATION_ASSERTIONS_SILENT=y

# ============================================
# FreeRTOS
# ============================================
CONFIG_FREERTOS_HZ=1000
CONFIG_FREERTOS_TASK_NOTIFICATION_ARRAY_ENTRIES=1

# ============================================
# Logging
# ============================================
CONFIG_LOG_DEFAULT_LEVEL_INFO=y
CONFIG_LOG_MAXIMUM_LEVEL_DEBUG=y

# ============================================
# Disable Unused Features (Save Space)
# ============================================
CONFIG_BT_ENABLED=n

# ============================================
# VFS Support
# ============================================
CONFIG_VFS_SUPPORT_IO=y
```
